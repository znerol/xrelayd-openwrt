## openwrt-whiterussian/host/Config.in
```kconfig
config BR2_PACKAGE_HOST
	prompt "host.............................. used to query DNS servers for domain names and zones"
	tristate
	default m if CONFIG_DEVEL
	help
		http://packages.debian.org/stable/host
```

## openwrt-whiterussian/xrelayd/Config.in
```kconfig
config BR2_PACKAGE_XRELAY
	prompt "xrelay............................ stunnel replacement based on xyssl"
	tristate
	default m if CONFIG_DEVEL
	selects BR2_PACKAGE_XYSSL
	depends BR2_PACKAGE_XYSSL
	help
		http://www.xyssl.org
```

## openwrt-whiterussian/xyssl/Config.in
```kconfig
config BR2_PACKAGE_XYSSL
	prompt "xyssl............................. Fast, open source implementation of SSL"
	tristate
	default m if CONFIG_DEVEL
	help
		http://www.xyssl.org
```
